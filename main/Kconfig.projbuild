## main/Kconfig.projbuild
```kconfig
menu "Application configuration"

  config WIFI_AP_SSID
    string "WiFi access point SSID"
    default "energy_meter#%s"
    help
      Each device creates an access point, which is used to configure it at
      IP 192.168.4.1. The Sdefault SID name is defined here, which can be made
      unique by including MAC id of the device using '%s', e.g. energy_meter#%s
      => energy_meter#1e2e3e4e5e6e.

  config WIFI_AP_PASSWORD
    string "WiFi access point password"
    default "admin#%s"
    help
      The default access point password is defined here, which case be made
      unique by including MAC id of the device using '%s', e.g. admin#%s
      => admin#1e2e3e4e5e6e.

  config WIFI_STA_SSID
    string "WiFi station target SSID"
    default "energy_meter"
    help
      Each device connects to an access point, which is used to communicate
      measurements and other related information through the internet. The
      default SSID name is defined here.

  config WIFI_STA_PASSWORD
    string "WiFi station target password"
    default "energy_meter"
    help
      The default password of the access point this device connects to is
      defined here.


  config MQTT_BROKER_URL
    string "MQTT broker URL"
    default "mqtt://test.mosquitto.org:1883"
    help
      The default MQTT broker URL to which this device connects as a client.
      The device publishes all its data there.

  config MQTT_PUBLISH_INTERVAL
    int "MQTT publish interval"
    default 10000
    help
      The default MQTT publish interval for measurements.



  menu "I2C master"
  
    config I2C_MASTER_PORT
      int "I2C master port"
      default 0
      help
        The I2C master port number which connects to SHT21 sensor.

    config I2C_MASTER_SDA
      int "I2C master SDA pin"
      default 18
      help
        The I2C master SDA pin number.

    config I2C_MASTER_SCL
      int "I2C master SCL pin"
      default 19
      help
        The I2C master SCL pin number.

    config I2C_MASTER_CLK_SPEED
      int "I2C master clock speed"
      default 100000
      help
        The I2C master clock speed.

  endmenu

endmenu
```
